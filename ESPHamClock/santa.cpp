/* code to support santa easter egg
 */

#include "HamClock.h"

#define SANTA_C         RA8875_RED

#define SANTA_W 17
#define SANTA_H 50
static const uint8_t santa[SANTA_W*SANTA_H] PROGMEM = {
 0x00, 0x00, 0x00, 0x00, 0x00, 0x00, 0x00, 0x00, 0x00, 0x00, 0x00, 0x00, 0x00, 0x00, 0x00, 0x00, 0x00,
 0x00, 0x00, 0x00, 0x00, 0x00, 0x00, 0x00, 0x00, 0x00, 0x00, 0x00, 0x00, 0x00, 0x00, 0x00, 0x00, 0x00,
 0x00, 0x00, 0x00, 0x00, 0x00, 0x00, 0x00, 0x00, 0x00, 0x00, 0x18, 0x00, 0x00, 0x00, 0x00, 0x00, 0x00,
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 0x00, 0x30, 0x00, 0x00, 0x00, 0x00, 0x00, 0x00, 0x00, 0x00, 0x00, 0x00, 0x00, 0x00, 0x00, 0x00, 0x00,
};

#define SANTA_WPIX      (SANTA_W*8)     // width in pixels
#define SANTA_HPIX      (SANTA_H)       // height in pixels


// boundary box
SBox santa_b = {0, 0, SANTA_WPIX, SANTA_HPIX};

static void drawSantaBox(void)
{
    // Serial.printf ("Painting santa at %d x %d\n", santa_b.x, santa_b.y);
    resetWatchdog();
    for (uint16_t sr = 0; sr < SANTA_HPIX; sr++) {
        for (uint16_t sc = 0; sc < SANTA_W; sc++) {
            uint16_t mask = pgm_read_byte(&santa[sr*SANTA_W+sc]);
            for (uint16_t bc = 0; bc < 8; bc++) {
                uint16_t sx = tft.SCALESZ*santa_b.x + 8*sc + bc;
                uint16_t sy = tft.SCALESZ*santa_b.y + sr;
                if (mask & (1<<bc))
                    tft.drawPixelRaw (sx, sy, SANTA_C);
            }
        }
    }
}

static void eraseSantaBox(const SBox &s)
{
#if defined(_IS_ESP8266)
    // only ESP erases, UNIX just redraws the whole scene every update cycle.
    // Serial.printf ("Erasing santa from %d x %d\n", s.x, s.y);
    resetWatchdog();
    for (uint16_t sr = 0; sr < SANTA_HPIX; sr++) {
        for (uint16_t sc = 0; sc < SANTA_W; sc++) {
            for (uint16_t bc = 0; bc < 8; bc++) {
                uint16_t sx = s.x + 8*sc + bc;
                uint16_t sy = s.y + sr;
                SCoord ss = {sx, sy};
                drawMapCoord(ss);
            }
        }
    }
#else
    (void) s;
#endif // _IS_ESP8266
}


/* draw santa on christmas eve
 */
void drawSanta()
{
    // skip unless Christmas eve day
    time_t t = nowWO();
    if (month(t) != 12 || day(t) != 24) {
        santa_b.x = santa_b.y = 0;
        return;
    }

    resetWatchdog();

    // place so he moves over the globe througout the day.
    // left-right each hour, top-bottom throughout the day

    float hr_frac = hour(t)/23.0F;
    float mn_frac = minute(t)/59.0F;

    // location now before next iteration
    SBox s0 = santa_b;

    // handy
    const uint16_t hw = map_b.w/2;
    const uint16_t hh = map_b.h/2;
    const uint16_t xc = map_b.x + hw;
    const uint16_t yc = map_b.y + hh;

    // position onto globe
    switch ((MapProjection)map_proj) {
    case MAPP_MERCATOR: {
        // fit within full map_b
        uint16_t y_t = map_b.y + 1;
        uint16_t y_b = map_b.y + map_b.h - SANTA_HPIX - 1;
        santa_b.y = y_t + hr_frac*(y_b-y_t);
        uint16_t x_l = map_b.x + 1;
        uint16_t x_r = map_b.x + map_b.w - SANTA_WPIX - 1;
        santa_b.x = x_l + mn_frac*(x_r-x_l);
        }
        break;
    
    case MAPP_ROB: {
        uint16_t tb_border = SANTA_HPIX/2;                              // top/bot border
        uint16_t y_t = map_b.y + tb_border;                             // santa_b.y at hr 0
        uint16_t y_b = map_b.y + map_b.h - tb_border - SANTA_HPIX;      // santa_b.y at hr 23
        santa_b.y = y_t + hr_frac*(y_b-y_t);                            // santa_b.y now
        uint16_t y_hw;                                                  // globe half-width 
        if (santa_b.y < yc-SANTA_HPIX/2) {                              // test using top or bottom of box
            y_hw = hw * RobLat2G (90*(yc - santa_b.y)/hh);              // globe half-width at santa top
        } else {
            y_hw = hw * RobLat2G (90*(yc - santa_b.y - SANTA_HPIX)/hh); // globe half-width at santa bottom
        }
        uint16_t x_l = xc - y_hw;
        uint16_t x_r = xc + y_hw - SANTA_WPIX;
        santa_b.x = x_l + mn_frac*(x_r-x_l);                            // spread x along [x_l,x_r]
        }
        break;
    
    case MAPP_AZIMUTHAL: {
        // fit within one of two circles
        uint16_t tb_border = SANTA_HPIX/2;                              // top/bot border
        uint16_t y_t = map_b.y + tb_border;                             // santa_b.y at hr 0
        uint16_t y_b = map_b.y + map_b.h - tb_border - SANTA_HPIX;      // santa_b.y at hr 23
        santa_b.y = y_t + hr_frac*(y_b-y_t);                            // santa_b.y now
        float y_frac;
        if (santa_b.y < yc-SANTA_HPIX/2)                                // test using top or bottom
            y_frac = (yc - santa_b.y)/(float)hh;                        // overall y fraction on santa top
        else
            y_frac = (santa_b.y + SANTA_HPIX - yc)/(float)hh;           // overall y fraction on santa bottom
        uint16_t ew = hh * sqrtf(1 - y_frac*y_frac);                    // half-width to each edge
        uint16_t x_l, x_r;
        if (mn_frac < 0.5F) {                                           // test left or right hemisphere
            x_l = xc - hh - ew;                                         // left edge left hemi
            x_r = xc - hh + ew - SANTA_WPIX;                            // right edge left hemi
            santa_b.x = x_l + 2*mn_frac*(x_r-x_l);                      // spread x along [x_l,x_r] first half
        } else {
            x_l = xc + hh - ew;                                         // left edge right hemi
            x_r = xc + hh + ew - SANTA_WPIX;                            // right edge right hemi
            santa_b.x = x_l + 2*(mn_frac-0.5F)*(x_r-x_l);               // spread x along [x_l,x_r] secnd half
        }
        }
        break;
    
    case MAPP_AZIM1: {
        // fit within central circle
        uint16_t tb_border = SANTA_HPIX/2;                              // top/bot border
        uint16_t y_t = map_b.y + tb_border;                             // santa_b.y at hr 0
        uint16_t y_b = map_b.y + map_b.h - tb_border - SANTA_HPIX;      // santa_b.y at hr 23
        santa_b.y = y_t + hr_frac*(y_b-y_t);                            // santa_b.y now
        float y_frac;
        if (santa_b.y < yc-SANTA_HPIX/2)                                // test using top or bottom
            y_frac = (yc - santa_b.y)/(float)hh;                        // overall y fraction on santa top
        else
            y_frac = (santa_b.y + SANTA_HPIX - yc)/(float)hh;           // overall y fraction on santa bottom
        uint16_t ew = hw/2 * sqrtf(1 - y_frac*y_frac);                  // half-width to each edge
        uint16_t x_l = xc - ew;                                         // left edge
        uint16_t x_r = xc + ew - SANTA_WPIX;                            // right edge
        santa_b.x = x_l + mn_frac*(x_r-x_l);                            // spread x along [x_l,x_r] by minutes
        }
        break;

    default:
        fatalError (_FX("drawSanta() map_proj %d"), map_proj);
    }


    // erase if previously drawn and has now moved 
    if (s0.x && (santa_b.x != s0.x || santa_b.y != s0.y))
        eraseSantaBox (s0);

    // draw if over map else mark as not drawn
    if (overMap (santa_b))
        drawSantaBox();
    else
        santa_b.x = 0;
}
